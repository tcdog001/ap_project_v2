## qsdk/package/capp/busybox/autelan/Config.in
```kconfig
#
# For a description of the syntax of this configuration file,
# see scripts/kbuild/config-language.txt.
#

menu "Autelan Utils"

config APPKEY
	bool "appkey"
	default y
	help
	  appkey

config ATCOOKIE
	bool "atcookie"
	default y
	help
	  atcookie

config JLOGGER
	bool "jlogger"
	default y
	help
	  jlogger

config JLOGD
	bool "jlogd"
	default y
	help
	  jlogd

config SMONITORC
	bool "smonitorc"
	default y
	help
	  smonitorc

config SMONITORD
	bool "smonitord"
	default y
	help
	  smonitord

config STIMERC
	bool "stimerc"
	default y
	help
	  stimerc

config STIMERD
	bool "stimerd"
	default y
	help
	  stimerd

config UMC
	bool "umc"
	default y
	help
	  umc

config UMD
	bool "umd"
	default y
	help
	  umd
endmenu
```

## qsdk/package/capp/busybox2/autelan/Config.in
```kconfig
#
# For a description of the syntax of this configuration file,
# see scripts/kbuild/config-language.txt.
#

menu "Autelan Utils"

config APPKEY
	bool "appkey"
	default y
	help
	  appkey

#AUTELAN

config AT_TTYUSB0
	bool "at_ttyUSB0"
	default y
	help
	  at_ttyUSB0

config AT_TTYUSB1
	bool "at_ttyUSB1"
	default y
	help
	  at_ttyUSB1

config AT_TTYUSB3
	bool "at_ttyUSB3"
	default y
	help
	  at_ttyUSB3

config ATCHECK
	bool "atcheck"
	default y
	help
	  atcheck

config ATCOOKIE
	bool "atcookie"
	default y
	help
	  atcookie

config ATDOG
	bool "atdog"
	default y
	help
	  atdog

config ATENV
	bool "atenv"
	default y
	help
	  atenv

config ATOTP
	bool "atotp"
	default y
	help
	  atotp

config ATRT
	bool "atrt"
	default y
	help
	  atrt

config ATSS
	bool "atss"
	default y
	help
	  atss

config ATSYS
	bool "atsys"
	default y
	help
	  atsys

config JLOGGER
	bool "jlogger"
	default y
	help
	  jlogger

config JLOGD
	bool "jlogd"
	default y
	help
	  jlogd

#AUTELAN

config PPP_DIAL
	bool "ppp_dial"
	default y
	help
	  ppp_dial

config SINETD
	bool "sinetd"
	default y
	help
	  sinetd

config SMONITORC
	bool "smonitorc"
	default y
	help
	  smonitorc

config SMONITORD
	bool "smonitord"
	default y
	help
	  smonitord

config STIMERC
	bool "stimerc"
	default y
	help
	  stimerc

config STIMERD
	bool "stimerd"
	default y
	help
	  stimerd

config UMC
	bool "umc"
	default y
	help
	  umc

config UMD
	bool "umd"
	default y
	help
	  umd

endmenu
```
